
    keymap {
        compatible = "zmk,keymap";
        win_layer {
            label = "Windows";
            bindings = <
// ╭────────────────┬────────────────┬────────────────┬────────────────┬────────────────┬────────────────╮                                   ╭────────────────┬────────────────┬────────────────┬────────────────┬────────────────┬────────────────╮
          ^                1                2                   3              4                5                                                      6              7                  8               9                                ´                                                                     
// ├────────────────┼────────────────┼────────────────┼────────────────┼────────────────┼────────────────┤                                   ├────────────────┼────────────────┼────────────────┼────────────────┼────────────────┼────────────────┤
          ESC              x  X             v V             l L             c C             w W                                                    k K            h H               g G              f F              q Q             ß ?
// ├────────────────┼────────────────┼────────────────┼────────────────┼────────────────┼────────────────┤                                   ├────────────────┼────────────────┼────────────────┼────────────────┼────────────────┼────────────────┤
      LSHIFT TAB       u U                  i I              a A            e E              o O                                                    s S               n N             r R          t T                d D               y  Y
// ├────────────────┼────────────────┼────────────────┼────────────────┼────────────────┼────────────────┤────────────────╮ ╭────────────────┼────────────────┼────────────────┼────────────────┼────────────────┼────────────────┤────────────────┤
        CTRL                            ö Ö                ä Ä                    p P        z Z                                                   b B            m M                   , ;         . :               j  J               - _
// ╰────────────────┴────────────────┼────────────────┼────────────────┼────────────────┼────────────────┤────────────────┤ ├────────────────┼────────────────┼────────────────┼────────────────┼────────────────┼────────────────┴────────────────╯
                                          LGUI               SYM             LALT             SPACE            NUM                SYM             RSHIFT RET         RALT             öNUM          rgb_white
//                                   ╰────────────────┴────────────────┴────────────────┴────────────────┴────────────────╯ ╰────────────────┴────────────────┴────────────────┴────────────────┴────────────────╯
            >;
            sensor-bindings = <&inc_dec_kp C_VOL_UP C_VOL_DN &inc_dec_kp PG_UP PG_DN>;
        };
// -------------------------------------------------------------------------------------------------------------------------------------------------------------------------------------------------------------------------------------------------
        gme_layer {
            label = "Gaming";
            bindings = <
// ╭────────────────┬────────────────┬────────────────┬────────────────┬────────────────┬────────────────╮                                   ╭────────────────┬────────────────┬────────────────┬────────────────┬────────────────┬────────────────╮
        &                   1                 2           3               4                     5                                                  6                    7           8               9                                  ^
// ├────────────────┼────────────────┼────────────────┼────────────────┼────────────────┼────────────────┤                                   ├────────────────┼────────────────┼────────────────┼────────────────┼────────────────┼────────────────┤
           ESC          x X                v V              l L              c C            w W                                                  k K              h H                g G               f F              q Q          XXXXXX
// ├────────────────┼────────────────┼────────────────┼────────────────┼────────────────┼────────────────┤                                   ├────────────────┼────────────────┼────────────────┼────────────────┼────────────────┼────────────────┤
          LSHIFT         u U             i I             a A                  e E             o O                                                  s S               n N             r R              t T            d D              y Y
// ├────────────────┼────────────────┼────────────────┼────────────────┼────────────────┼────────────────┤────────────────╮ ╭────────────────┼────────────────┼────────────────┼────────────────┼────────────────┼────────────────┼────────────────┤
           LCTRL                        . :                ß ?            p P               z Z                                   XXXXXX           b B             m M                 , ;               . :              j J            ß ?
// ╰────────────────┴────────────────┼────────────────┼────────────────┼────────────────┼────────────────┤────────────────┤ ├────────────────┼────────────────┼────────────────┼────────────────┼────────────────┼────────────────┴────────────────╯
                                           XXXXXX           XXXXXX         &kp TAB          &kp SPACE         &mo WEA            &mo SYM          &kp RET         &kp LALT          &mo ADJ        rgb_purple
//                                   ╰────────────────┴────────────────┴────────────────┴────────────────┴────────────────╯ ╰────────────────┴────────────────┴────────────────┴────────────────┴────────────────╯
            >;
            sensor-bindings = <&inc_dec_kp C_VOL_UP C_VOL_DN &inc_dec_kp PG_UP PG_DN>;
        };
// -------------------------------------------------------------------------------------------------------------------------------------------------------------------------------------------------------------------------------------------------
        num_layer {
            label = "Number";
            bindings = <

// ╭────────────────┬────────────────┬────────────────┬────────────────┬────────────────┬────────────────╮                                   ╭────────────────┬────────────────┬────────────────┬────────────────┬────────────────┬────────────────╮
         XXXXXX           XXXXXX           XXXXXX           XXXXXX           XXXXXX           XXXXXX                                             &kp LS(TAB)    &kp KP_MULTIPLY   &kp KP_DIVIDE       XXXXXX           XXXXXX          &kp LNLCK
// ├────────────────┼────────────────┼────────────────┼────────────────┼────────────────┼────────────────┤                                   ├────────────────┼────────────────┼────────────────┼────────────────┼────────────────┼────────────────┤
         ______         &kp PAGE_UP       &kp BSPC           &kp UP          &kp DEL       &kp PAGE_DOWN                                          &kp N7            &kp N8           &kp N9        &kp KP_MINUS        XXXXXX           XXXXXX
// ├────────────────┼────────────────┼────────────────┼────────────────┼────────────────┼────────────────┤                                   ├────────────────┼────────────────┼────────────────┼────────────────┼────────────────┼────────────────┤
         &kp TAB         &kp HOME         &kp LEFT         &kp DOWN         &kp RIGHT        &kp END                                              &kp N4            &kp N5           &kp N6        &kp KP_PLUS         XXXXXX           XXXXXX
// ├────────────────┼────────────────┼────────────────┼────────────────┼────────────────┼────────────────┤────────────────╮ ╭────────────────┼────────────────┼────────────────┼────────────────┼────────────────┼────────────────┼────────────────┤
         &kp LC(S)        XXXXXX          &kp INS          &kp RET           XXXXXX         &kp LC(DE_Z)       ______             ______          &kp N1            &kp N2           &kp N3         &kp KP_DOT         XXXXXX           XXXXXX
// ╰────────────────┴────────────────┼────────────────┼────────────────┼────────────────┼────────────────┤────────────────┤ ├────────────────┼────────────────┼────────────────┼────────────────┼────────────────┼────────────────┴────────────────╯
                                           &kp RET          ______           ______           ______           ______             ______           ______           &kp N0        &kp KP_COMMA       XXXXXX
//                                   ╰────────────────┴────────────────┴────────────────┴────────────────┴────────────────╯ ╰────────────────┴────────────────┴────────────────┴────────────────┴────────────────╯
            >;
            sensor-bindings = <&inc_dec_kp C_VOL_UP C_VOL_DN &inc_dec_kp PG_UP PG_DN>;
        };
// -------------------------------------------------------------------------------------------------------------------------------------------------------------------------------------------------------------------------------------------------
        sym_layer {
            label = "Symbole";
            bindings = <
// ╭────────────────┬────────────────┬────────────────┬────────────────┬────────────────┬────────────────╮                                   ╭────────────────┬────────────────┬────────────────┬────────────────┬────────────────┬────────────────╮
        &kp F1            &kp F2           &kp F3           &kp F4           &kp F5           &kp F6                                               &kp F7           &kp F8           &kp F9           &kp F10          &kp F11         &kp F12
// ├────────────────┼────────────────┼────────────────┼────────────────┼────────────────┼────────────────┤                                   ├────────────────┼────────────────┼────────────────┼────────────────┼────────────────┼────────────────┤
         ______          @                 _                 [                ]                 ^                                                    !                #                   ' '          =              &                €
// ├────────────────┼────────────────┼────────────────┼────────────────┼────────────────┼────────────────┤                                   ├────────────────┼────────────────┼────────────────┼────────────────┼────────────────┼────────────────┤
         ______         \                     /                   {            }               *                                                      ?               (               )                 -               Ö             §
// ├────────────────┼────────────────┼────────────────┼────────────────┼────────────────┼────────────────┤────────────────╮ ╭────────────────┼────────────────┼────────────────┼────────────────┼────────────────┼────────────────┼────────────────┤
         ______                            $                                   ~                  `                                                 +                %               "        "        ''                 ö             
// ╰────────────────┴────────────────┼────────────────┼────────────────┼────────────────┼────────────────┤────────────────┤ ├────────────────┼────────────────┼────────────────┼────────────────┼────────────────┼────────────────┴────────────────╯
                                           ______           ______           ______           ______           ______            ______            ______           ______           ______           ______
//                                   ╰────────────────┴────────────────┴────────────────┴────────────────┴────────────────╯ ╰────────────────┴────────────────┴────────────────┴────────────────┴────────────────╯
            >;
            sensor-bindings = <&inc_dec_cp C_VOL_UP C_VOL_DN &inc_dec_kp PG_UP PG_DN>;
        };
// -------------------------------------------------------------------------------------------------------------------------------------------------------------------------------------------------------------------------------------------------
        adj_layer {
            label = "Adjust";
            bindings = <
// ╭────────────────┬────────────────┬────────────────┬────────────────┬────────────────┬────────────────╮                                   ╭────────────────┬────────────────┬────────────────┬────────────────┬────────────────┬────────────────╮
       &bt BT_CLR      &bt BT_SEL 0     &bt BT_SEL 1     &bt BT_SEL 2     &bt BT_SEL 3     &bt BT_SEL 4                                             &reset          XXXXXX      &ext_power EP_ON &ext_power EP_OFF     XXXXXX           XXXXXX
// ├────────────────┼────────────────┼────────────────┼────────────────┼────────────────┼────────────────┤                                   ├────────────────┼────────────────┼────────────────┼────────────────┼────────────────┼────────────────┤
         XXXXXX       &rgb_ug RGB_HUD  &rgb_ug RGB_HUI  &rgb_ug RGB_SAD  &rgb_ug RGB_SAI  &rgb_ug RGB_EFF                                          XXXXXX           XXXXXX           XXXXXX           XXXXXX           XXXXXX           XXXXXX
// ├────────────────┼────────────────┼────────────────┼────────────────┼────────────────┼────────────────┤                                   ├────────────────┼────────────────┼────────────────┼────────────────┼────────────────┼────────────────┤
         XXXXXX       &rgb_ug RGB_BRD  &rgb_ug RGB_BRI     XXXXXX           XXXXXX           XXXXXX                                                XXXXXX           XXXXXX           XXXXXX           XXXXXX           XXXXXX           XXXXXX
// ├────────────────┼────────────────┼────────────────┼────────────────┼────────────────┼────────────────┤────────────────╮ ╭────────────────┼────────────────┼────────────────┼────────────────┼────────────────┼────────────────┼────────────────┤
        &kp LCTRL         XXXXXX           XXXXXX          XXXXXX           XXXXXX           XXXXXX        &rgb_ug RGB_TOG   &ext_power EP_TOG     XXXXXX           XXXXXX           XXXXXX           XXXXXX           XXXXXX           &tog GME
// ╰────────────────┴────────────────┼────────────────┼────────────────┼────────────────┼────────────────┤────────────────┤ ├────────────────┼────────────────┼────────────────┼────────────────┼────────────────┼────────────────┴────────────────╯
                                      &ext_power EP_TOG    XXXXXX           XXXXXX           XXXXXX            XXXXXX             XXXXXX           XXXXXX           XXXXXX           XXXXXX           XXXXXX
//                                   ╰────────────────┴────────────────┴────────────────┴────────────────┴────────────────╯ ╰────────────────┴────────────────┴────────────────┴────────────────┴────────────────╯
            >;
            sensor-bindings = <&inc_dec_kp C_VOL_UP C_VOL_DN &inc_dec_kp PG_UP PG_DN>;
        };
// -------------------------------------------------------------------------------------------------------------------------------------------------------------------------------------------------------------------------------------------------
        wea_layer {
            label = "Weapon";
            bindings = <
// ╭────────────────┬────────────────┬────────────────┬────────────────┬────────────────┬────────────────╮                                   ╭────────────────┬────────────────┬────────────────┬────────────────┬────────────────┬────────────────╮
         ______           ______           ______           ______           ______           ______                                               ______           ______           ______           ______           ______           ______
// ├────────────────┼────────────────┼────────────────┼────────────────┼────────────────┼────────────────┤                                   ├────────────────┼────────────────┼────────────────┼────────────────┼────────────────┼────────────────┤
         ______           k K           h H                g G              q Q                                                                    ______           ______           ______           ______           ______           ______
// ├────────────────┼────────────────┼────────────────┼────────────────┼────────────────┼────────────────┤                                   ├────────────────┼────────────────┼────────────────┼────────────────┼────────────────┼────────────────┤
         ______           s  S           n N               r R              d D             o O                                                    ______           ______           ______           ______           ______           ______
// ├────────────────┼────────────────┼────────────────┼────────────────┼────────────────┼────────────────┤────────────────╮ ╭────────────────┼────────────────┼────────────────┼────────────────┼────────────────┼────────────────┼────────────────┤
         ______                          m M            y Y               BACKSPACE            j       J       ______             ______           ______           ______           ______           ______           ______           &tog GME
// ╰────────────────┴────────────────┼────────────────┼────────────────┼────────────────┼────────────────┤────────────────┤ ├────────────────┼────────────────┼────────────────┼────────────────┼────────────────┼────────────────┴────────────────╯
                                           XXXXXX           XXXXXX           ______           ______           ______             ______           ______           ______           ______           ______
//                                   ╰────────────────┴────────────────┴────────────────┴────────────────┴────────────────╯ ╰────────────────┴────────────────┴────────────────┴────────────────┴────────────────╯
            >;
            sensor-bindings = <&inc_dec_kp C_VOL_UP C_VOL_DN &inc_dec_kp PG_UP PG_DN>;
        };
     };
};
