//Autoshift Macro - AS(Q) AS(W) AS(E) AS(R) AS(T) AS(Y) Autoshift applied for QWERTY keys
//#define HM(keycode, mods) &bhm mods keycode // HomeRow mods - HM(I, F5)
/ {
     combos {
        compatible = "zmk,combos";
        //COMBO(esckey, &kp ESC, 2 3) 
        //    name      output            pos.
        
        COMBO(brc,      &td_brc,          15 16)
        COMBO(cbr,      &td_cbr,          39 40)
        COMBO(prn,      &td_prn,          45 46)
        COMBO(abk,      &td_abk,          19 20)
        COMBO(at,       &kp DE_AT,        26 27)
        COMBO(dqou,     &kp DE_DQUO,      14 15)
        COMBO(quo,      &kp DE_QUOT,      20 21)
        COMBO(under,    &kp DE_UNDS,      16 17)
        COMBO(minus,    &kp DE_MINS,      18 19)
        COMBO(circ,     &kp NON_US_BSLH,  28 29)
        COMBO(slsh,     &kp DE_SLSH,      38 39)
        COMBO(bsls,     &kp DE_BSLS,      46 47)
        COMBO(tabl,     &kp TAB,          27 28)
        COMBO(tabr,     &kp TAB,          31 32)
        COMBO(hash,     &kp DE_HASH,      32 33)
    };

    behaviors {
        hm_l: homerow_mods_left {
            compatible = "zmk,behavior-hold-tap";
            label = "HOMEROW_MODS_L";
            #binding-cells = <2>;
            tapping-term-ms = <300>;
            quick-tap-ms = <250>;
            flavor = "tap-preferred";
            bindings = <&kp>, <&kp>;
        };
        hm_r: homerow_mods_right {
            compatible = "zmk,behavior-hold-tap";
            label = "HOMEROW_MODS_R";
            #binding-cells = <2>;
            tapping-term-ms = <300>;
            quick-tap-ms = <250>;
            flavor = "tap-preferred";
            bindings = <&kp>, <&kp>;
        }; 
        TAP_DANCE(brc, &kp DE_LBRC, &kp DE_RBRC)
        TAP_DANCE(cbr, &kp DE_LCBR, &kp DE_RCBR)
        TAP_DANCE(prn, &kp DE_LPRN, &kp DE_RPRN)
        TAP_DANCE(abk, &kp DE_CIRC, &kp DE_DEG)
    };
};