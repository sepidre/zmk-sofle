## config/west.yml
```yaml
manifest:
  remotes:
    - name: zmkfirmware
      url-base: https://github.com/zmkfirmware
    - name: infused-kim
      url-base: https://github.com/infused-kim
  projects:
    - name: zmk
      remote: zmkfirmware
      revision: main
      #remote: infused-kim
      #revision: my-changes/oled-ext-pwr
      import: app/west.yml
  self:
    path: config
```
